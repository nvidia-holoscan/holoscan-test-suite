## meta-holoscan-test-controls/conf/layer.conf
```bitbake
# SPDX-FileCopyrightText: Copyright (c) 2023 NVIDIA CORPORATION & AFFILIATES. All rights reserved.
# SPDX-License-Identifier: Apache-2.0
#
# Licensed under the Apache License, Version 2.0 (the "License");
# you may not use this file except in compliance with the License.
# You may obtain a copy of the License at
#
# http://www.apache.org/licenses/LICENSE-2.0
#
# Unless required by applicable law or agreed to in writing, software
# distributed under the License is distributed on an "AS IS" BASIS,
# WITHOUT WARRANTIES OR CONDITIONS OF ANY KIND, either express or implied.
# See the License for the specific language governing permissions and
# limitations under the License.

BBPATH .= ":${LAYERDIR}"
BBFILES += " \
    ${LAYERDIR}/recipes-*/*/*.bb \
    ${LAYERDIR}/recipes-*/*.bb \
"

BBFILE_COLLECTIONS += "holoscan-test-controls"
BBFILE_PATTERN_holoscan-test-controls = "^${LAYERDIR}/"
BBFILE_PRIORITY_holoscan-test-controls = "7"

LAYERVERSION_holoscan-test-controls = "1"

LAYERDEPENDS_holoscan-test-controls = "core tegra openembedded-layer"

LAYERSERIES_COMPAT_holoscan-test-controls = "kirkstone"
```
